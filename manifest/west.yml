## manifest/west.yml
```yaml
manifest:
  remotes:
    - name: zephyrproject
      url-base: https://github.com/zephyrproject-rtos
  projects:
    - name: zephyr
      repo-path: zephyr
      remote: zephyrproject
      revision: v4.1.0
      import:
        path-prefix: deps
        name-allowlist:
          - cmsis
          - cmsis-dsp
          - percepio
          - picolibc
          - segger
          - hal_espressif
```
